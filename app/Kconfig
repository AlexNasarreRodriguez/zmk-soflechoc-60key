## app/dts/bindings/behaviors/zmk,behavior-lang-toggle.yaml
```yaml
description: Nasarre Language Toggle Behavior

compatible: "nasarre,behavior-lang-toggle"

include: zmk,behavior.yaml

properties:
  label:
    type: string
    description: Behavior label

  '#binding-cells':
    type: int
    const: 0
    description: Number of parameters

  lang-eng:
    type: string
    description: Language code for English
    required: true

  lang-esp:
    type: string
    description: Language code for Spanish
    required: true
```

## app/src/behaviors/Kconfig
```kconfig
config ZMK_BEHAVIOR_LANG_TOGGLE
    bool "Language Toggle Behavior"
    default y
    help:
      Enable the language toggle behavior.
```

## config/west.yml
```yaml
manifest:
  remotes:
    - name: zmkfirmware
      url-base: https://github.com/zmkfirmware
    - name: AlexNasarreRodriguez
      url-base: https://github.com/AlexNasarreRodriguez
  projects:
    - name: zmk
      remote: zmkfirmware
      revision: main
      import: app/west.yml
    - name: ZMKlangbehavior
      remote: AlexNasarreRodriguez
      revision: master
      path: modules/ZMKlangbehavior
    - name: ZMKprommtbehaviors
      remote: AlexNasarreRodriguez
      revision: master
      path: modules/ZMKprommtbehaviors
  self:
    path: config
```
